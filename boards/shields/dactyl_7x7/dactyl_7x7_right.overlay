// Shield overlay files contain a devicetree description that is merged with the
// primary board devicetree description during the firmware building process.
// There are three main things that need to be defined in this file:

// # Your keyboard scan (kscan) driver, which determines which GPIO
// pins to scan for key press events
//
// # Your matrix transform, which acts as a "bridge" between the kscan and the keymap
// Your physical layout, which aggregates the above and (optionally)
// defines physical key positions so that the keyboard can be used with ZMK Studio.
//
// # A split keyboard will have an overlay file defined for each split part.
// For example, if the keyboard is split into a left and a right half, these can be named:

// dactyl_7x7_left.overlay
// dactyl_7x7_right.overlay
// Here dactyl_7x7_left and dactyl_7x7_right are the shield names
// defined in the Kconfig.shield file.

// Split keyboards often share some of their devicetree description.
// The standard approach is to have a core my_keyboard.dtsi (devicetree include) file,
// which is included into each of the shield overlays.

#include "dactyl_7x7.dtsi"
#include "trackball.dtsi"

&default_transform {
	col-offset = <7>;
};

&kscan0 {
	col-gpios
	= <&pro_micro 3 GPIO_ACTIVE_HIGH>
	, <&pro_micro 4 GPIO_ACTIVE_HIGH>
	, <&pro_micro 5 GPIO_ACTIVE_HIGH>
	, <&pro_micro 6 GPIO_ACTIVE_HIGH>
	, <&pro_micro 7 GPIO_ACTIVE_HIGH>
	, <&pro_micro 8 GPIO_ACTIVE_HIGH>
	, <&pro_micro 9 GPIO_ACTIVE_HIGH>
	;
};
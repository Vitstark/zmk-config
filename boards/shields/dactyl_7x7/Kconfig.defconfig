## boards/shields/dactyl_7x7/Kconfig.defconfig
```kconfig
if DACTYL_RIGHT

config ZMK_KEYBOARD_NAME
    default "DACTYL"

config ZMK_SPLIT_ROLE_CENTRAL
    default y

endif

if DACTYL_LEFT || DACTYL_RIGHT

config ZMK_SPLIT
    default y

config ZMK_BLE_EXPERIMENTAL_CONN
    default y

endif
```

## boards/shields/dactyl_7x7/Kconfig.shield
```kconfig
# The Kconfig.shield file defines the shield name used to build your keyboard.

# Split keyboards have multiple shield names defined, one for each part.
# For example, if your keyboard consists of two halves named dactyl_7x7_left and dactyl_7x7_right,
# it would look like this:

# No whitespace after the comma or in your part name!
config DACTYL_LEFT
    def_bool $(shields_list_contains, dactyl_7x7_left)

# No whitespace after the comma or in your part name!
config DACTYL_RIGHT
    def_bool $(shields_list_contains, dactyl_7x7_right)

# This will set the DACTYL_LEFT flag to y whenever dactyl_7x7_left is used as the shield name.
# Likewise, when dactyl_7x7_right is used as the shield name DACTYL_RIGHT flag is set to y.
# The DACTYL_LEFT and DACTYL_RIGHT flags will be used in
# Kconfig.defconfig to set other properties about your shields, so make sure that they match.
```

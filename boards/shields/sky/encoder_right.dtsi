right_encoder: encoder_rgiht {
	compatible = "alps,ec11";
	a-gpios = <PIN_A (GPIO_ACTIVE_HIGH | GPIO_PULL_UP)>;
	b-gpios = <PIN_B (GPIO_ACTIVE_HIGH | GPIO_PULL_UP)>;
	steps = <50>;
	status = "disabled";
};
#include "sky.dtsi"
#include "trackball.dtsi"

&default_transform {
	col-offset = <7>;
};

&kscan0 {
	row-gpios
	= <&pro_micro 21 (GPIO_ACTIVE_HIGH | GPIO_PULL_DOWN)>
	, <&pro_micro 9 (GPIO_ACTIVE_HIGH | GPIO_PULL_DOWN)>
	, <&pro_micro 8 (GPIO_ACTIVE_HIGH | GPIO_PULL_DOWN)>
	, <&pro_micro 7 (GPIO_ACTIVE_HIGH | GPIO_PULL_DOWN)>
	, <&pro_micro 6 (GPIO_ACTIVE_HIGH | GPIO_PULL_DOWN)>
	;

	col-gpios
	= <&pro_micro 20 GPIO_ACTIVE_HIGH>
	, <&pro_micro 19 GPIO_ACTIVE_HIGH>
	, <&gpio1 2 GPIO_ACTIVE_HIGH>
	, <&gpio1 7 GPIO_ACTIVE_HIGH>
	, <&pro_micro 14 GPIO_ACTIVE_HIGH>
	, <&pro_micro 16 GPIO_ACTIVE_HIGH>
	, <&pro_micro 10 GPIO_ACTIVE_HIGH>
	;
};

&right_encoder {
	status = "okay";
};
